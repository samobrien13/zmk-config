## config/west.yml
```yaml
manifest:
  defaults:
    remote: urob
    revision: v0.3

  remotes:
    - name: zmkfirmware
      url-base: https://github.com/zmkfirmware
    - name: urob
      url-base: https://github.com/urob
  projects:
    - name: zmk
      remote: zmkfirmware
      import: app/west.yml

    # Modules
    - name: zmk-helpers
      path: modules/zmk/helpers

  self:
    path: config
```
